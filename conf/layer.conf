## conf/layer.conf
```bitbake
# We have conf and classes directory, add to BBPATH
BBPATH .= ":${LAYERDIR}"

# We have recipes-* directories, add to BBFILES
BBFILES += "${LAYERDIR}/recipes-*/*/*.bb \
            ${LAYERDIR}/recipes-*/*/*.bbappend"

BBFILE_COLLECTIONS += "meta-rauc-stm"
BBFILE_PATTERN_meta-rauc-stm = "^${LAYERDIR}/"
BBFILE_PRIORITY_meta-rauc-stm = "6"

# Use underscore syntax for older BitBake versions
LAYERDEPENDS_meta-rauc-stm = "core rauc stm-st-stm32mp"
LAYERSERIES_COMPAT_meta-rauc-stm = "scarthgap"

# IMPORTANT: Use := to expand ${LAYERDIR} IMMEDIATELY
# Don't use ?= or ??= - they delay expansion until it's too late
RAUC_KEY_FILE := "${LAYERDIR}/../files/rauc-example-keys/development-1.key.pem"
RAUC_CERT_FILE := "${LAYERDIR}/../files/rauc-example-keys/development-1.cert.pem"
RAUC_KEYRING_FILE := "${LAYERDIR}/../files/rauc-example-keys/ca.cert.pem"
```
